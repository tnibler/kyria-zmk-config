/*
 * Copyright (c) 2020 Pete Johanson
 *
 * SPDX-License-Identifier: MIT
 */

#include "chippy.dtsi"

&five_column_transform {
	col-offset = <5>;
};

&kscan0 {
	col-gpios
		= <&gpio0 10 GPIO_ACTIVE_HIGH>  //Col0
		, <&gpio1 12 GPIO_ACTIVE_HIGH>  //Col1
		, <&gpio1 13 GPIO_ACTIVE_HIGH>  //Col2
		, <&gpio1 14 GPIO_ACTIVE_HIGH>  //Col3
		, <&gpio1 15 GPIO_ACTIVE_HIGH>  //Col4
		;

		row-gpios
			= <&gpio0 9 (GPIO_ACTIVE_HIGH | GPIO_PULL_DOWN)>
			, <&gpio0 3 (GPIO_ACTIVE_HIGH | GPIO_PULL_DOWN)>
			, <&gpio0 28 (GPIO_ACTIVE_HIGH | GPIO_PULL_DOWN)>
			, <&gpio0 29 (GPIO_ACTIVE_HIGH | GPIO_PULL_DOWN)>
			;
};
